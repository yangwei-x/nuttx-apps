## examples/traced/Kconfig
```kconfig
#
# For a description of the syntax of this configuration file,
# see the file kconfig-language.txt in the NuttX tools repository.
#

config EXAMPLES_TRACED
	tristate "Trace daemon example"
	default n
	depends on NET_UDP
	---help---
		Enable the Trace daemon example

if EXAMPLES_TRACED

config EXAMPLES_TRACED_NOMAC
	bool "Use Canned MAC Address"
	default n
	---help---
		If the hardware has no MAC address of its own, define this =y to
		provide a bogus address for testing.

config EXAMPLES_TRACED_IPADDR
	hex "Target IP address"
	default 0xCA801F63
	---help---
		The target IP address.  Default 192.168.31.99 (0xCA801F63)

config EXAMPLES_TRACED_IPPORT
	hex "Target IP port"
	default 6000
	---help---
		The target IP part.  Default 6000

config EXAMPLES_TRACED_DRIPADDR
	hex "Default Router IP address (Gateway)"
	default 0x0a000001
	---help---
		The default router address. Default 10.0.0.1 (0x0a000001)

config EXAMPLES_TRACED_NETMASK
	hex "Network Mask"
	default 0xffffff00
	---help---
		The network mask.  Default: 255.255.255.0 (0xffffff00)

config EXAMPLES_TRACED_DAEMONPRIO
	int "Trace daemon priority"
	default 100
	---help---
		Priority of the Traced server daemon.  Default: 100

config EXAMPLES_TRACED_DAEMONSTACKSIZE
	int "Trace daemon stack size"
	default DEFAULT_TASK_STACKSIZE
	---help---
		Stack size allocated for the Trace daemon. Default: 4096

config EXAMPLES_TRACED_CLIENTPRIO
	int "Trace client priority"
	default 100
	---help---
		Priority of the Trace client.  Default: 100

config EXAMPLES_TRACED_CLIENTSTACKSIZE
	int "Trace client stack size"
	default DEFAULT_TASK_STACKSIZE
	---help---
		Stack size allocated for the Trace client. Default: 2048

config EXAMPLES_TRACED_BUFFER_SIZE
	int "Trace message buffer size"
	default 1024
	---help---
		Trace message buffer size. Default: 1024

config EXAMPLES_TRACED_METRIC_PERIOD
	int "Trace report metric period"
	default 6000
	---help---
		Trace report metric period. Default: 6000

endif
```
